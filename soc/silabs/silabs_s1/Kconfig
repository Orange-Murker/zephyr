## soc/silabs/silabs_s1/Kconfig
```kconfig
# Copyright (c) 2024 GARDENA GmbH
# SPDX-License-Identifier: Apache-2.0

if SOC_FAMILY_SILABS_S1

config SOC_FAMILY_SILABS_S1
	select HAS_SEGGER_RTT if ZEPHYR_SEGGER_MODULE
	select BUILD_OUTPUT_HEX
	select SOC_EARLY_INIT_HOOK

configdefault SYS_CLOCK_HW_CYCLES_PER_SEC
	default $(dt_node_int_prop_int,/cpus/cpu@0,clock-frequency) if CORTEX_M_SYSTICK
	default 32768

configdefault SYS_CLOCK_TICKS_PER_SEC
	default 128 if !TICKLESS_KERNEL && SILABS_SLEEPTIMER_TIMER

configdefault CORTEX_M_SYSTICK
	default n if SILABS_SLEEPTIMER_TIMER

rsource "*/Kconfig"

endif
```

## soc/silabs/silabs_s1/efr32bg1b/Kconfig
```kconfig
config SOC_SERIES_EFR32BG1B
	select ARM
	select CPU_CORTEX_M4
	select CPU_HAS_FPU
	select CPU_HAS_ARM_MPU
	select SOC_GECKO_HAS_RADIO
	select HAS_SILABS_GECKO
	select HAS_SWO
	select SOC_GECKO_HAS_INDIVIDUAL_PIN_LOCATION
	select SOC_GECKO_CMU
	select SOC_GECKO_EMU
	select SOC_GECKO_GPIO
	select SOC_GECKO_RTCC
	select HAS_PM

config SOC_GECKO_SDID
	default 80 if SOC_SERIES_EFR32BG1B
```

## soc/silabs/silabs_s1/efr32bg1b/Kconfig.defconfig
```kconfig
if SOC_SERIES_EFR32BG1B

config NUM_IRQS
	# must be >= the highest interrupt number used
	default 35

endif
```

## soc/silabs/silabs_s1/efr32bg1b/Kconfig.soc
```kconfig
config SOC_SERIES_EFR32BG1B
	bool
	select SOC_FAMILY_SILABS_S1
	help
	  Silicon Labs EFR32BG1B (Blue Gecko) Series MCU

config SOC_PART_NUMBER_EFR32BG1B132F256GM48
	bool
	select SOC_SERIES_EFR32BG1B

config SOC_SERIES
	default "efr32bg1b" if SOC_SERIES_EFR32BG1B

config SOC
	default "efr32bg1b132f256gm48" if SOC_PART_NUMBER_EFR32BG1B132F256GM48
```
